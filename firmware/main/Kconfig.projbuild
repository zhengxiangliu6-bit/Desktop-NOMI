## firmware/main/Kconfig.projbuild
```kconfig
menu "Desktop-NOMI H2 local audio"
choice NOMI_WAKE_PROFILE
    prompt "Local audio/recognition profile"
    default NOMI_WAKE_AUDIO_ONLY
    config NOMI_WAKE_AUDIO_ONLY
        bool "Audio + AFE only; Xiaomi Tongxue unavailable"
    config NOMI_WAKE_BENCHMARK
        bool "BENCHMARK ONLY: Xiaoai Tongxue (not Xiaomi Tongxue)"
        select SR_WN_WN9_XIAOAITONGXUE
    config NOMI_VOICE_COMMANDS
        bool "Offline Chinese commands with configurable activation phrase (MultiNet7)"
        select SR_MN_CN_MULTINET7_QUANT
    config NOMI_WIFI_VOICE
        bool "BOOT button short recording with HTTPS transcription gateway"
    config NOMI_USB_ASR
        bool "USB microphone transport for Windows local Chinese transcription (no device ASR/actions)"
endchoice
config NOMI_VOICE_WAKE_LABEL
    string "Activation phrase display label"
    depends on NOMI_VOICE_COMMANDS
    default "小米同学"
config NOMI_VOICE_WAKE_PINYIN
    string "Activation phrase spoken pinyin (lowercase, space separated, no tones)"
    depends on NOMI_VOICE_COMMANDS
    default "xiao mi tong xue"
if NOMI_WIFI_VOICE
config NOMI_WIFI_SSID
    string "Wi-Fi SSID"
config NOMI_WIFI_PASSWORD
    string "Wi-Fi password"
config NOMI_WIFI_VOICE_URL
    string "HTTPS voice gateway URL including /device/voice"
config NOMI_WIFI_DEVICE_TOKEN
    string "Device gateway token"
endif
endmenu
```

## firmware/sdkconfig.defaults
```kconfig
CONFIG_IDF_TARGET="esp32s3"
CONFIG_ESPTOOLPY_FLASHMODE_QIO=y
CONFIG_ESPTOOLPY_FLASHSIZE_16MB=y
CONFIG_PARTITION_TABLE_CUSTOM=y
CONFIG_PARTITION_TABLE_CUSTOM_FILENAME="partitions.csv"
CONFIG_SPIRAM=y
CONFIG_SPIRAM_MODE_OCT=y
CONFIG_SPIRAM_SPEED_80M=y
CONFIG_SPIRAM_USE_MALLOC=y
CONFIG_ESP_DEFAULT_CPU_FREQ_MHZ_240=y
CONFIG_FREERTOS_HZ=1000
CONFIG_ESP_MAIN_TASK_STACK_SIZE=8192
CONFIG_ESP_CONSOLE_USB_SERIAL_JTAG=y
CONFIG_LV_COLOR_DEPTH_16=y
CONFIG_LV_OS_NONE=y
CONFIG_LV_USE_CLIB_MALLOC=y
CONFIG_LV_USE_CLIB_STRING=y
CONFIG_LV_USE_CLIB_SPRINTF=y
CONFIG_LV_BUILD_EXAMPLES=n
CONFIG_LV_BUILD_DEMOS=n
CONFIG_LV_USE_LOG=n
CONFIG_ESP_MAIN_TASK_AFFINITY_CPU1=y
CONFIG_FREERTOS_USE_TRACE_FACILITY=y
CONFIG_FREERTOS_GENERATE_RUN_TIME_STATS=y
CONFIG_NOMI_WAKE_AUDIO_ONLY=y
CONFIG_SR_NSN_WEBRTC=y
CONFIG_SR_VADN_WEBRTC=y
CONFIG_SR_MN_CN_NONE=y
CONFIG_SR_MN_EN_NONE=y
CONFIG_MODEL_IN_FLASH=y
CONFIG_CODEC_ES8311_SUPPORT=y
CONFIG_CODEC_ES7210_SUPPORT=y
CONFIG_CODEC_ES7243_SUPPORT=n
CONFIG_CODEC_ES7243E_SUPPORT=n
CONFIG_CODEC_ES8156_SUPPORT=n
CONFIG_CODEC_AW88298_SUPPORT=n
CONFIG_CODEC_ES8389_SUPPORT=n
CONFIG_CODEC_ES8374_SUPPORT=n
CONFIG_CODEC_ES8388_SUPPORT=n
CONFIG_CODEC_TAS5805M_SUPPORT=n
CONFIG_CODEC_CJC8910_SUPPORT=n
CONFIG_CODEC_DUMMY_SUPPORT=n
CONFIG_CODEC_I2C_BACKWARD_COMPATIBLE=n
```
