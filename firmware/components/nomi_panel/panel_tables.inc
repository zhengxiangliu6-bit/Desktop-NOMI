// Derived from Waveshare BSP at 5a98b8da1948340c07032a408ac0d93c47ca558f.
// Apache-2.0; extracted without changing the two panel revision tables.
static const uint8_t lcd_cmd_data_0[] = {0x28};
static const uint8_t lcd_cmd_data_1[] = {0x28};
static const uint8_t lcd_cmd_data_2[] = {0xD1};
static const uint8_t lcd_cmd_data_3[] = {0xE0};
static const uint8_t lcd_cmd_data_4[] = {0x61};
static const uint8_t lcd_cmd_data_5[] = {0x82};
static const uint8_t lcd_cmd_data_6[] = {0x00};
static const uint8_t lcd_cmd_data_7[] = {0x01};
static const uint8_t lcd_cmd_data_8[] = {0x01};
static const uint8_t lcd_cmd_data_9[] = {0x49};
static const uint8_t lcd_cmd_data_10[] = {0x4A};
static const uint8_t lcd_cmd_data_11[] = {0x1F};
static const uint8_t lcd_cmd_data_12[] = {0x46};
static const uint8_t lcd_cmd_data_13[] = {0x34};
static const uint8_t lcd_cmd_data_14[] = {0xD5};
static const uint8_t lcd_cmd_data_15[] = {0x30};
static const uint8_t lcd_cmd_data_16[] = {0x04};
static const uint8_t lcd_cmd_data_17[] = {0x00};
static const uint8_t lcd_cmd_data_18[] = {0x08};
static const uint8_t lcd_cmd_data_19[] = {0x08};
static const uint8_t lcd_cmd_data_20[] = {0x00};
static const uint8_t lcd_cmd_data_21[] = {0x80};
static const uint8_t lcd_cmd_data_22[] = {0x10};
static const uint8_t lcd_cmd_data_23[] = {0x37};
static const uint8_t lcd_cmd_data_24[] = {0x80};
static const uint8_t lcd_cmd_data_25[] = {0x10};
static const uint8_t lcd_cmd_data_26[] = {0x37};
static const uint8_t lcd_cmd_data_27[] = {0xA9};
static const uint8_t lcd_cmd_data_28[] = {0x41};
static const uint8_t lcd_cmd_data_29[] = {0x01};
static const uint8_t lcd_cmd_data_30[] = {0xA9};
static const uint8_t lcd_cmd_data_31[] = {0x41};
static const uint8_t lcd_cmd_data_32[] = {0x01};
static const uint8_t lcd_cmd_data_33[] = {0x91};
static const uint8_t lcd_cmd_data_34[] = {0x68};
static const uint8_t lcd_cmd_data_35[] = {0x68};
static const uint8_t lcd_cmd_data_36[] = {0x00, 0xA5};
static const uint8_t lcd_cmd_data_37[] = {0x35};
static const uint8_t lcd_cmd_data_38[] = {0x35};
static const uint8_t lcd_cmd_data_39[] = {0x3F};
static const uint8_t lcd_cmd_data_40[] = {0x3F};
static const uint8_t lcd_cmd_data_41[] = {0x10};
static const uint8_t lcd_cmd_data_42[] = {0x00};
static const uint8_t lcd_cmd_data_43[] = {0x02};
static const uint8_t lcd_cmd_data_44[] = {0x70, 0x09, 0x12, 0x0C, 0x0B, 0x27, 0x38, 0x54, 0x4E, 0x19, 0x15, 0x15, 0x2C, 0x2F};
static const uint8_t lcd_cmd_data_45[] = {0x70, 0x08, 0x11, 0x0C, 0x0B, 0x27, 0x38, 0x43, 0x4C, 0x18, 0x14, 0x14, 0x2B, 0x2D};
static const uint8_t lcd_cmd_data_46[] = {0xF0, 0x0E, 0x15, 0x0B, 0x0B, 0x07, 0x3C, 0x44, 0x51, 0x38, 0x15, 0x15, 0x32, 0x36};
static const uint8_t lcd_cmd_data_47[] = {0xF0, 0x0D, 0x15, 0x0A, 0x0A, 0x26, 0x3B, 0x43, 0x50, 0x37, 0x14, 0x15, 0x31, 0x36};
static const uint8_t lcd_cmd_data_48[] = {0x10};
static const uint8_t lcd_cmd_data_49[] = {0x10};
static const uint8_t lcd_cmd_data_50[] = {0x08};
static const uint8_t lcd_cmd_data_51[] = {0x00};
static const uint8_t lcd_cmd_data_52[] = {0x0B};
static const uint8_t lcd_cmd_data_53[] = {0x00};
static const uint8_t lcd_cmd_data_54[] = {0xE0};
static const uint8_t lcd_cmd_data_55[] = {0x06};
static const uint8_t lcd_cmd_data_56[] = {0x21};
static const uint8_t lcd_cmd_data_57[] = {0x00};
static const uint8_t lcd_cmd_data_58[] = {0x05};
static const uint8_t lcd_cmd_data_59[] = {0x82};
static const uint8_t lcd_cmd_data_60[] = {0xDF};
static const uint8_t lcd_cmd_data_61[] = {0x89};
static const uint8_t lcd_cmd_data_62[] = {0x20};
static const uint8_t lcd_cmd_data_63[] = {0x14};
static const uint8_t lcd_cmd_data_64[] = {0xFF};
static const uint8_t lcd_cmd_data_65[] = {0x00};
static const uint8_t lcd_cmd_data_66[] = {0xFF};
static const uint8_t lcd_cmd_data_67[] = {0x00};
static const uint8_t lcd_cmd_data_68[] = {0x00};
static const uint8_t lcd_cmd_data_69[] = {0x30};
static const uint8_t lcd_cmd_data_70[] = {0x00};
static const uint8_t lcd_cmd_data_71[] = {0x00};
static const uint8_t lcd_cmd_data_72[] = {0x00};
static const uint8_t lcd_cmd_data_73[] = {0x00};
static const uint8_t lcd_cmd_data_74[] = {0x42};
static const uint8_t lcd_cmd_data_75[] = {0xE0};
static const uint8_t lcd_cmd_data_76[] = {0x40};
static const uint8_t lcd_cmd_data_77[] = {0x40};
static const uint8_t lcd_cmd_data_78[] = {0x02};
static const uint8_t lcd_cmd_data_79[] = {0x00};
static const uint8_t lcd_cmd_data_80[] = {0x40};
static const uint8_t lcd_cmd_data_81[] = {0x03};
static const uint8_t lcd_cmd_data_82[] = {0x00};
static const uint8_t lcd_cmd_data_83[] = {0x00};
static const uint8_t lcd_cmd_data_84[] = {0x00};
static const uint8_t lcd_cmd_data_85[] = {0x00};
static const uint8_t lcd_cmd_data_86[] = {0x42};
static const uint8_t lcd_cmd_data_87[] = {0xE0};
static const uint8_t lcd_cmd_data_88[] = {0x40};
static const uint8_t lcd_cmd_data_89[] = {0x40};
static const uint8_t lcd_cmd_data_90[] = {0x02};
static const uint8_t lcd_cmd_data_91[] = {0x00};
static const uint8_t lcd_cmd_data_92[] = {0x40};
static const uint8_t lcd_cmd_data_93[] = {0x03};
static const uint8_t lcd_cmd_data_94[] = {0x00};
static const uint8_t lcd_cmd_data_95[] = {0x00};
static const uint8_t lcd_cmd_data_96[] = {0x00};
static const uint8_t lcd_cmd_data_97[] = {0x00};
static const uint8_t lcd_cmd_data_98[] = {0x38};
static const uint8_t lcd_cmd_data_99[] = {0x38};
static const uint8_t lcd_cmd_data_100[] = {0x00};
static const uint8_t lcd_cmd_data_101[] = {0x04};
static const uint8_t lcd_cmd_data_102[] = {0x04};
static const uint8_t lcd_cmd_data_103[] = {0x02};
static const uint8_t lcd_cmd_data_104[] = {0xDC};
static const uint8_t lcd_cmd_data_105[] = {0xDC};
static const uint8_t lcd_cmd_data_106[] = {0x00};
static const uint8_t lcd_cmd_data_107[] = {0x00};
static const uint8_t lcd_cmd_data_108[] = {0x00};
static const uint8_t lcd_cmd_data_109[] = {0x38};
static const uint8_t lcd_cmd_data_110[] = {0x38};
static const uint8_t lcd_cmd_data_111[] = {0x00};
static const uint8_t lcd_cmd_data_112[] = {0x06};
static const uint8_t lcd_cmd_data_113[] = {0x06};
static const uint8_t lcd_cmd_data_114[] = {0x02};
static const uint8_t lcd_cmd_data_115[] = {0xDE};
static const uint8_t lcd_cmd_data_116[] = {0xDE};
static const uint8_t lcd_cmd_data_117[] = {0x00};
static const uint8_t lcd_cmd_data_118[] = {0x00};
static const uint8_t lcd_cmd_data_119[] = {0x00};
static const uint8_t lcd_cmd_data_120[] = {0x38};
static const uint8_t lcd_cmd_data_121[] = {0x38};
static const uint8_t lcd_cmd_data_122[] = {0x00};
static const uint8_t lcd_cmd_data_123[] = {0x08};
static const uint8_t lcd_cmd_data_124[] = {0x08};
static const uint8_t lcd_cmd_data_125[] = {0x02};
static const uint8_t lcd_cmd_data_126[] = {0xE0};
static const uint8_t lcd_cmd_data_127[] = {0xE0};
static const uint8_t lcd_cmd_data_128[] = {0x00};
static const uint8_t lcd_cmd_data_129[] = {0x00};
static const uint8_t lcd_cmd_data_130[] = {0x00};
static const uint8_t lcd_cmd_data_131[] = {0x38};
static const uint8_t lcd_cmd_data_132[] = {0x38};
static const uint8_t lcd_cmd_data_133[] = {0x00};
static const uint8_t lcd_cmd_data_134[] = {0x0A};
static const uint8_t lcd_cmd_data_135[] = {0x0A};
static const uint8_t lcd_cmd_data_136[] = {0x02};
static const uint8_t lcd_cmd_data_137[] = {0xE2};
static const uint8_t lcd_cmd_data_138[] = {0xE2};
static const uint8_t lcd_cmd_data_139[] = {0x00};
static const uint8_t lcd_cmd_data_140[] = {0x00};
static const uint8_t lcd_cmd_data_141[] = {0x00};
static const uint8_t lcd_cmd_data_142[] = {0x38};
static const uint8_t lcd_cmd_data_143[] = {0x38};
static const uint8_t lcd_cmd_data_144[] = {0x00};
static const uint8_t lcd_cmd_data_145[] = {0x03};
static const uint8_t lcd_cmd_data_146[] = {0x03};
static const uint8_t lcd_cmd_data_147[] = {0x02};
static const uint8_t lcd_cmd_data_148[] = {0xDB};
static const uint8_t lcd_cmd_data_149[] = {0xDB};
static const uint8_t lcd_cmd_data_150[] = {0x00};
static const uint8_t lcd_cmd_data_151[] = {0x00};
static const uint8_t lcd_cmd_data_152[] = {0x00};
static const uint8_t lcd_cmd_data_153[] = {0x38};
static const uint8_t lcd_cmd_data_154[] = {0x38};
static const uint8_t lcd_cmd_data_155[] = {0x00};
static const uint8_t lcd_cmd_data_156[] = {0x05};
static const uint8_t lcd_cmd_data_157[] = {0x05};
static const uint8_t lcd_cmd_data_158[] = {0x02};
static const uint8_t lcd_cmd_data_159[] = {0xDD};
static const uint8_t lcd_cmd_data_160[] = {0xDD};
static const uint8_t lcd_cmd_data_161[] = {0x00};
static const uint8_t lcd_cmd_data_162[] = {0x00};
static const uint8_t lcd_cmd_data_163[] = {0x00};
static const uint8_t lcd_cmd_data_164[] = {0x38};
static const uint8_t lcd_cmd_data_165[] = {0x38};
static const uint8_t lcd_cmd_data_166[] = {0x00};
static const uint8_t lcd_cmd_data_167[] = {0x07};
static const uint8_t lcd_cmd_data_168[] = {0x07};
static const uint8_t lcd_cmd_data_169[] = {0x02};
static const uint8_t lcd_cmd_data_170[] = {0xDF};
static const uint8_t lcd_cmd_data_171[] = {0xDF};
static const uint8_t lcd_cmd_data_172[] = {0x00};
static const uint8_t lcd_cmd_data_173[] = {0x00};
static const uint8_t lcd_cmd_data_174[] = {0x00};
static const uint8_t lcd_cmd_data_175[] = {0x38};
static const uint8_t lcd_cmd_data_176[] = {0x38};
static const uint8_t lcd_cmd_data_177[] = {0x00};
static const uint8_t lcd_cmd_data_178[] = {0x09};
static const uint8_t lcd_cmd_data_179[] = {0x09};
static const uint8_t lcd_cmd_data_180[] = {0x02};
static const uint8_t lcd_cmd_data_181[] = {0xE1};
static const uint8_t lcd_cmd_data_182[] = {0xE1};
static const uint8_t lcd_cmd_data_183[] = {0x00};
static const uint8_t lcd_cmd_data_184[] = {0x00};
static const uint8_t lcd_cmd_data_185[] = {0x00};
static const uint8_t lcd_cmd_data_186[] = {0x22};
static const uint8_t lcd_cmd_data_187[] = {0x22};
static const uint8_t lcd_cmd_data_188[] = {0xAA};
static const uint8_t lcd_cmd_data_189[] = {0x65};
static const uint8_t lcd_cmd_data_190[] = {0x74};
static const uint8_t lcd_cmd_data_191[] = {0x47};
static const uint8_t lcd_cmd_data_192[] = {0x56};
static const uint8_t lcd_cmd_data_193[] = {0x00};
static const uint8_t lcd_cmd_data_194[] = {0x88};
static const uint8_t lcd_cmd_data_195[] = {0x99};
static const uint8_t lcd_cmd_data_196[] = {0x33};
static const uint8_t lcd_cmd_data_197[] = {0x11};
static const uint8_t lcd_cmd_data_198[] = {0x11};
static const uint8_t lcd_cmd_data_199[] = {0xAA};
static const uint8_t lcd_cmd_data_200[] = {0x65};
static const uint8_t lcd_cmd_data_201[] = {0x74};
static const uint8_t lcd_cmd_data_202[] = {0x47};
static const uint8_t lcd_cmd_data_203[] = {0x56};
static const uint8_t lcd_cmd_data_204[] = {0x00};
static const uint8_t lcd_cmd_data_205[] = {0x88};
static const uint8_t lcd_cmd_data_206[] = {0x99};
static const uint8_t lcd_cmd_data_207[] = {0x33};
static const uint8_t lcd_cmd_data_208[] = {0x01};
static const uint8_t lcd_cmd_data_209[] = {0x00};
static const uint8_t lcd_cmd_data_210[] = {0x55};
static const uint8_t lcd_cmd_data_211[] = {0x00};
static const uint8_t lcd_cmd_data_212[] = {0x00};
static const uint8_t lcd_cmd_data_213[] = {0x00};
static const uint8_t lcd_cmd_data_214[] = {0x00};
static const uint8_t lcd_cmd_data_215[] = {0x28};
static const uint8_t lcd_cmd_data_216[] = {0x28};
static const uint8_t lcd_cmd_data_217[] = {0xF0};
static const uint8_t lcd_cmd_data_218[] = {0xD1};
static const uint8_t lcd_cmd_data_219[] = {0xE0};
static const uint8_t lcd_cmd_data_220[] = {0x61};
static const uint8_t lcd_cmd_data_221[] = {0x82};
static const uint8_t lcd_cmd_data_222[] = {0x00};
static const uint8_t lcd_cmd_data_223[] = {0x01};
static const uint8_t lcd_cmd_data_224[] = {0x01};
static const uint8_t lcd_cmd_data_225[] = {0x56};
static const uint8_t lcd_cmd_data_226[] = {0x4D};
static const uint8_t lcd_cmd_data_227[] = {0x24};
static const uint8_t lcd_cmd_data_228[] = {0x87};
static const uint8_t lcd_cmd_data_229[] = {0x44};
static const uint8_t lcd_cmd_data_230[] = {0x8B};
static const uint8_t lcd_cmd_data_231[] = {0x40};
static const uint8_t lcd_cmd_data_232[] = {0x86};
static const uint8_t lcd_cmd_data_233[] = {0x00};
static const uint8_t lcd_cmd_data_234[] = {0x08};
static const uint8_t lcd_cmd_data_235[] = {0x08};
static const uint8_t lcd_cmd_data_236[] = {0x00};
static const uint8_t lcd_cmd_data_237[] = {0x80};
static const uint8_t lcd_cmd_data_238[] = {0x10};
static const uint8_t lcd_cmd_data_239[] = {0x37};
static const uint8_t lcd_cmd_data_240[] = {0x80};
static const uint8_t lcd_cmd_data_241[] = {0x10};
static const uint8_t lcd_cmd_data_242[] = {0x37};
static const uint8_t lcd_cmd_data_243[] = {0xA9};
static const uint8_t lcd_cmd_data_244[] = {0x41};
static const uint8_t lcd_cmd_data_245[] = {0x01};
static const uint8_t lcd_cmd_data_246[] = {0xA9};
static const uint8_t lcd_cmd_data_247[] = {0x41};
static const uint8_t lcd_cmd_data_248[] = {0x01};
static const uint8_t lcd_cmd_data_249[] = {0x91};
static const uint8_t lcd_cmd_data_250[] = {0x68};
static const uint8_t lcd_cmd_data_251[] = {0x68};
static const uint8_t lcd_cmd_data_252[] = {0x00, 0xA5};
static const uint8_t lcd_cmd_data_253[] = {0x4F};
static const uint8_t lcd_cmd_data_254[] = {0x4F};
static const uint8_t lcd_cmd_data_255[] = {0x10};
static const uint8_t lcd_cmd_data_256[] = {0x00};
static const uint8_t lcd_cmd_data_257[] = {0x02};
static const uint8_t lcd_cmd_data_258[] = {0xF0, 0x0A, 0x10, 0x09, 0x09, 0x36, 0x35, 0x33, 0x4A, 0x29, 0x15, 0x15, 0x2E, 0x34};
static const uint8_t lcd_cmd_data_259[] = {0xF0, 0x0A, 0x0F, 0x08, 0x08, 0x05, 0x34, 0x33, 0x4A, 0x39, 0x15, 0x15, 0x2D, 0x33};
static const uint8_t lcd_cmd_data_260[] = {0x10};
static const uint8_t lcd_cmd_data_261[] = {0x10};
static const uint8_t lcd_cmd_data_262[] = {0x07};
static const uint8_t lcd_cmd_data_263[] = {0x00};
static const uint8_t lcd_cmd_data_264[] = {0x00};
static const uint8_t lcd_cmd_data_265[] = {0x00};
static const uint8_t lcd_cmd_data_266[] = {0xE0};
static const uint8_t lcd_cmd_data_267[] = {0x06};
static const uint8_t lcd_cmd_data_268[] = {0x21};
static const uint8_t lcd_cmd_data_269[] = {0x01};
static const uint8_t lcd_cmd_data_270[] = {0x05};
static const uint8_t lcd_cmd_data_271[] = {0x02};
static const uint8_t lcd_cmd_data_272[] = {0xDA};
static const uint8_t lcd_cmd_data_273[] = {0x00};
static const uint8_t lcd_cmd_data_274[] = {0x00};
static const uint8_t lcd_cmd_data_275[] = {0x0F};
static const uint8_t lcd_cmd_data_276[] = {0x00};
static const uint8_t lcd_cmd_data_277[] = {0x00};
static const uint8_t lcd_cmd_data_278[] = {0x00};
static const uint8_t lcd_cmd_data_279[] = {0x00};
static const uint8_t lcd_cmd_data_280[] = {0x00};
static const uint8_t lcd_cmd_data_281[] = {0x00};
static const uint8_t lcd_cmd_data_282[] = {0x00};
static const uint8_t lcd_cmd_data_283[] = {0x00};
static const uint8_t lcd_cmd_data_284[] = {0x00};
static const uint8_t lcd_cmd_data_285[] = {0x00};
static const uint8_t lcd_cmd_data_286[] = {0x40};
static const uint8_t lcd_cmd_data_287[] = {0x04};
static const uint8_t lcd_cmd_data_288[] = {0x00};
static const uint8_t lcd_cmd_data_289[] = {0x42};
static const uint8_t lcd_cmd_data_290[] = {0xD9};
static const uint8_t lcd_cmd_data_291[] = {0x00};
static const uint8_t lcd_cmd_data_292[] = {0x00};
static const uint8_t lcd_cmd_data_293[] = {0x00};
static const uint8_t lcd_cmd_data_294[] = {0x00};
static const uint8_t lcd_cmd_data_295[] = {0x00};
static const uint8_t lcd_cmd_data_296[] = {0x00};
static const uint8_t lcd_cmd_data_297[] = {0x00};
static const uint8_t lcd_cmd_data_298[] = {0x40};
static const uint8_t lcd_cmd_data_299[] = {0x03};
static const uint8_t lcd_cmd_data_300[] = {0x00};
static const uint8_t lcd_cmd_data_301[] = {0x42};
static const uint8_t lcd_cmd_data_302[] = {0xD8};
static const uint8_t lcd_cmd_data_303[] = {0x00};
static const uint8_t lcd_cmd_data_304[] = {0x00};
static const uint8_t lcd_cmd_data_305[] = {0x00};
static const uint8_t lcd_cmd_data_306[] = {0x00};
static const uint8_t lcd_cmd_data_307[] = {0x00};
static const uint8_t lcd_cmd_data_308[] = {0x00};
static const uint8_t lcd_cmd_data_309[] = {0x00};
static const uint8_t lcd_cmd_data_310[] = {0x48};
static const uint8_t lcd_cmd_data_311[] = {0x00};
static const uint8_t lcd_cmd_data_312[] = {0x06};
static const uint8_t lcd_cmd_data_313[] = {0x02};
static const uint8_t lcd_cmd_data_314[] = {0xD6};
static const uint8_t lcd_cmd_data_315[] = {0x04};
static const uint8_t lcd_cmd_data_316[] = {0x00};
static const uint8_t lcd_cmd_data_317[] = {0x00};
static const uint8_t lcd_cmd_data_318[] = {0x48};
static const uint8_t lcd_cmd_data_319[] = {0x00};
static const uint8_t lcd_cmd_data_320[] = {0x08};
static const uint8_t lcd_cmd_data_321[] = {0x02};
static const uint8_t lcd_cmd_data_322[] = {0xD8};
static const uint8_t lcd_cmd_data_323[] = {0x04};
static const uint8_t lcd_cmd_data_324[] = {0x00};
static const uint8_t lcd_cmd_data_325[] = {0x00};
static const uint8_t lcd_cmd_data_326[] = {0x48};
static const uint8_t lcd_cmd_data_327[] = {0x00};
static const uint8_t lcd_cmd_data_328[] = {0x0A};
static const uint8_t lcd_cmd_data_329[] = {0x02};
static const uint8_t lcd_cmd_data_330[] = {0xDA};
static const uint8_t lcd_cmd_data_331[] = {0x04};
static const uint8_t lcd_cmd_data_332[] = {0x00};
static const uint8_t lcd_cmd_data_333[] = {0x00};
static const uint8_t lcd_cmd_data_334[] = {0x48};
static const uint8_t lcd_cmd_data_335[] = {0x00};
static const uint8_t lcd_cmd_data_336[] = {0x0C};
static const uint8_t lcd_cmd_data_337[] = {0x02};
static const uint8_t lcd_cmd_data_338[] = {0xDC};
static const uint8_t lcd_cmd_data_339[] = {0x04};
static const uint8_t lcd_cmd_data_340[] = {0x00};
static const uint8_t lcd_cmd_data_341[] = {0x00};
static const uint8_t lcd_cmd_data_342[] = {0x48};
static const uint8_t lcd_cmd_data_343[] = {0x00};
static const uint8_t lcd_cmd_data_344[] = {0x05};
static const uint8_t lcd_cmd_data_345[] = {0x02};
static const uint8_t lcd_cmd_data_346[] = {0xD5};
static const uint8_t lcd_cmd_data_347[] = {0x04};
static const uint8_t lcd_cmd_data_348[] = {0x00};
static const uint8_t lcd_cmd_data_349[] = {0x00};
static const uint8_t lcd_cmd_data_350[] = {0x48};
static const uint8_t lcd_cmd_data_351[] = {0x00};
static const uint8_t lcd_cmd_data_352[] = {0x07};
static const uint8_t lcd_cmd_data_353[] = {0x02};
static const uint8_t lcd_cmd_data_354[] = {0xD7};
static const uint8_t lcd_cmd_data_355[] = {0x04};
static const uint8_t lcd_cmd_data_356[] = {0x00};
static const uint8_t lcd_cmd_data_357[] = {0x00};
static const uint8_t lcd_cmd_data_358[] = {0x48};
static const uint8_t lcd_cmd_data_359[] = {0x00};
static const uint8_t lcd_cmd_data_360[] = {0x09};
static const uint8_t lcd_cmd_data_361[] = {0x02};
static const uint8_t lcd_cmd_data_362[] = {0xD9};
static const uint8_t lcd_cmd_data_363[] = {0x04};
static const uint8_t lcd_cmd_data_364[] = {0x00};
static const uint8_t lcd_cmd_data_365[] = {0x00};
static const uint8_t lcd_cmd_data_366[] = {0x48};
static const uint8_t lcd_cmd_data_367[] = {0x00};
static const uint8_t lcd_cmd_data_368[] = {0x0B};
static const uint8_t lcd_cmd_data_369[] = {0x02};
static const uint8_t lcd_cmd_data_370[] = {0xDB};
static const uint8_t lcd_cmd_data_371[] = {0x04};
static const uint8_t lcd_cmd_data_372[] = {0x00};
static const uint8_t lcd_cmd_data_373[] = {0x00};
static const uint8_t lcd_cmd_data_374[] = {0x10};
static const uint8_t lcd_cmd_data_375[] = {0x47};
static const uint8_t lcd_cmd_data_376[] = {0x56};
static const uint8_t lcd_cmd_data_377[] = {0x65};
static const uint8_t lcd_cmd_data_378[] = {0x74};
static const uint8_t lcd_cmd_data_379[] = {0x88};
static const uint8_t lcd_cmd_data_380[] = {0x99};
static const uint8_t lcd_cmd_data_381[] = {0x01};
static const uint8_t lcd_cmd_data_382[] = {0xBB};
static const uint8_t lcd_cmd_data_383[] = {0xAA};
static const uint8_t lcd_cmd_data_384[] = {0x10};
static const uint8_t lcd_cmd_data_385[] = {0x47};
static const uint8_t lcd_cmd_data_386[] = {0x56};
static const uint8_t lcd_cmd_data_387[] = {0x65};
static const uint8_t lcd_cmd_data_388[] = {0x74};
static const uint8_t lcd_cmd_data_389[] = {0x88};
static const uint8_t lcd_cmd_data_390[] = {0x99};
static const uint8_t lcd_cmd_data_391[] = {0x01};
static const uint8_t lcd_cmd_data_392[] = {0xBB};
static const uint8_t lcd_cmd_data_393[] = {0xAA};
static const uint8_t lcd_cmd_data_394[] = {0x01};
static const uint8_t lcd_cmd_data_395[] = {0x00};
static const uint8_t lcd_cmd_data_396[] = {0x00};
static const uint8_t lcd_cmd_data_397[] = {0x00};
static const uint8_t lcd_cmd_data_398[] = {0x00};
static const uint8_t lcd_cmd_data_399[] = {0x00};

static const st77916_lcd_init_cmd_t vendor_specific_init_version_1[] = {
    {0xF0, lcd_cmd_data_0, 1, 0},
    {0xF2, lcd_cmd_data_1, 1, 0},
    {0x7C, lcd_cmd_data_2, 1, 0},
    {0x83, lcd_cmd_data_3, 1, 0},
    {0x84, lcd_cmd_data_4, 1, 0},
    {0xF2, lcd_cmd_data_5, 1, 0},
    {0xF0, lcd_cmd_data_6, 1, 0},
    {0xF0, lcd_cmd_data_7, 1, 0},
    {0xF1, lcd_cmd_data_8, 1, 0},
    {0xB0, lcd_cmd_data_9, 1, 0},
    {0xB1, lcd_cmd_data_10, 1, 0},
    {0xB2, lcd_cmd_data_11, 1, 0},
    {0xB4, lcd_cmd_data_12, 1, 0},
    {0xB5, lcd_cmd_data_13, 1, 0},
    {0xB6, lcd_cmd_data_14, 1, 0},
    {0xB7, lcd_cmd_data_15, 1, 0},
    {0xB8, lcd_cmd_data_16, 1, 0},
    {0xBA, lcd_cmd_data_17, 1, 0},
    {0xBB, lcd_cmd_data_18, 1, 0},
    {0xBC, lcd_cmd_data_19, 1, 0},
    {0xBD, lcd_cmd_data_20, 1, 0},
    {0xC0, lcd_cmd_data_21, 1, 0},
    {0xC1, lcd_cmd_data_22, 1, 0},
    {0xC2, lcd_cmd_data_23, 1, 0},
    {0xC3, lcd_cmd_data_24, 1, 0},
    {0xC4, lcd_cmd_data_25, 1, 0},
    {0xC5, lcd_cmd_data_26, 1, 0},
    {0xC6, lcd_cmd_data_27, 1, 0},
    {0xC7, lcd_cmd_data_28, 1, 0},
    {0xC8, lcd_cmd_data_29, 1, 0},
    {0xC9, lcd_cmd_data_30, 1, 0},
    {0xCA, lcd_cmd_data_31, 1, 0},
    {0xCB, lcd_cmd_data_32, 1, 0},
    {0xD0, lcd_cmd_data_33, 1, 0},
    {0xD1, lcd_cmd_data_34, 1, 0},
    {0xD2, lcd_cmd_data_35, 1, 0},
    {0xF5, lcd_cmd_data_36, 2, 0},
    // {0xDD, lcd_cmd_data_37, 1, 0},
    // {0xDE, lcd_cmd_data_38, 1, 0},
    // {0xDD, lcd_cmd_data_39, 1, 0},
    // {0xDE, lcd_cmd_data_40, 1, 0},
    {0xF1, lcd_cmd_data_41, 1, 0},
    {0xF0, lcd_cmd_data_42, 1, 0},
    {0xF0, lcd_cmd_data_43, 1, 0},
    {0xE0, lcd_cmd_data_44, 14, 0},
    {0xE1, lcd_cmd_data_45, 14, 0},
    // {0xE0, lcd_cmd_data_46, 14, 0},
    // {0xE1, lcd_cmd_data_47, 14, 0},
    {0xF0, lcd_cmd_data_48, 1, 0},
    {0xF3, lcd_cmd_data_49, 1, 0},
    {0xE0, lcd_cmd_data_50, 1, 0},
    {0xE1, lcd_cmd_data_51, 1, 0},
    {0xE2, lcd_cmd_data_52, 1, 0},
    {0xE3, lcd_cmd_data_53, 1, 0},
    {0xE4, lcd_cmd_data_54, 1, 0},
    {0xE5, lcd_cmd_data_55, 1, 0},
    {0xE6, lcd_cmd_data_56, 1, 0},
    {0xE7, lcd_cmd_data_57, 1, 0},
    {0xE8, lcd_cmd_data_58, 1, 0},
    {0xE9, lcd_cmd_data_59, 1, 0},
    {0xEA, lcd_cmd_data_60, 1, 0},
    {0xEB, lcd_cmd_data_61, 1, 0},
    {0xEC, lcd_cmd_data_62, 1, 0},
    {0xED, lcd_cmd_data_63, 1, 0},
    {0xEE, lcd_cmd_data_64, 1, 0},
    {0xEF, lcd_cmd_data_65, 1, 0},
    {0xF8, lcd_cmd_data_66, 1, 0},
    {0xF9, lcd_cmd_data_67, 1, 0},
    {0xFA, lcd_cmd_data_68, 1, 0},
    {0xFB, lcd_cmd_data_69, 1, 0},
    {0xFC, lcd_cmd_data_70, 1, 0},
    {0xFD, lcd_cmd_data_71, 1, 0},
    {0xFE, lcd_cmd_data_72, 1, 0},
    {0xFF, lcd_cmd_data_73, 1, 0},
    {0x60, lcd_cmd_data_74, 1, 0},
    {0x61, lcd_cmd_data_75, 1, 0},
    {0x62, lcd_cmd_data_76, 1, 0},
    {0x63, lcd_cmd_data_77, 1, 0},
    {0x64, lcd_cmd_data_78, 1, 0},
    {0x65, lcd_cmd_data_79, 1, 0},
    {0x66, lcd_cmd_data_80, 1, 0},
    {0x67, lcd_cmd_data_81, 1, 0},
    {0x68, lcd_cmd_data_82, 1, 0},
    {0x69, lcd_cmd_data_83, 1, 0},
    {0x6A, lcd_cmd_data_84, 1, 0},
    {0x6B, lcd_cmd_data_85, 1, 0},
    {0x70, lcd_cmd_data_86, 1, 0},
    {0x71, lcd_cmd_data_87, 1, 0},
    {0x72, lcd_cmd_data_88, 1, 0},
    {0x73, lcd_cmd_data_89, 1, 0},
    {0x74, lcd_cmd_data_90, 1, 0},
    {0x75, lcd_cmd_data_91, 1, 0},
    {0x76, lcd_cmd_data_92, 1, 0},
    {0x77, lcd_cmd_data_93, 1, 0},
    {0x78, lcd_cmd_data_94, 1, 0},
    {0x79, lcd_cmd_data_95, 1, 0},
    {0x7A, lcd_cmd_data_96, 1, 0},
    {0x7B, lcd_cmd_data_97, 1, 0},
    // {0x80, lcd_cmd_data_98, 1, 0},
    {0x80, lcd_cmd_data_99, 1, 0},
    {0x81, lcd_cmd_data_100, 1, 0},
    // {0x82, lcd_cmd_data_101, 1, 0},
    {0x82, lcd_cmd_data_102, 1, 0},
    {0x83, lcd_cmd_data_103, 1, 0},
    // {0x84, lcd_cmd_data_104, 1, 0},
    {0x84, lcd_cmd_data_105, 1, 0},
    {0x85, lcd_cmd_data_106, 1, 0},
    {0x86, lcd_cmd_data_107, 1, 0},
    {0x87, lcd_cmd_data_108, 1, 0},
    // {0x88, lcd_cmd_data_109, 1, 0},
    {0x88, lcd_cmd_data_110, 1, 0},
    {0x89, lcd_cmd_data_111, 1, 0},
    // {0x8A, lcd_cmd_data_112, 1, 0},
    {0x8A, lcd_cmd_data_113, 1, 0},
    {0x8B, lcd_cmd_data_114, 1, 0},
    // {0x8C, lcd_cmd_data_115, 1, 0},
    {0x8C, lcd_cmd_data_116, 1, 0},
    {0x8D, lcd_cmd_data_117, 1, 0},
    {0x8E, lcd_cmd_data_118, 1, 0},
    {0x8F, lcd_cmd_data_119, 1, 0},
    // {0x90, lcd_cmd_data_120, 1, 0},
    {0x90, lcd_cmd_data_121, 1, 0},
    {0x91, lcd_cmd_data_122, 1, 0},
    // {0x92, lcd_cmd_data_123, 1, 0},
    {0x92, lcd_cmd_data_124, 1, 0},
    {0x93, lcd_cmd_data_125, 1, 0},
    // {0x94, lcd_cmd_data_126, 1, 0},
    {0x94, lcd_cmd_data_127, 1, 0},
    {0x95, lcd_cmd_data_128, 1, 0},
    {0x96, lcd_cmd_data_129, 1, 0},
    {0x97, lcd_cmd_data_130, 1, 0},
    // {0x98, lcd_cmd_data_131, 1, 0},
    {0x98, lcd_cmd_data_132, 1, 0},
    {0x99, lcd_cmd_data_133, 1, 0},
    // {0x9A, lcd_cmd_data_134, 1, 0},
    {0x9A, lcd_cmd_data_135, 1, 0},
    {0x9B, lcd_cmd_data_136, 1, 0},
    // {0x9C, lcd_cmd_data_137, 1, 0},
    {0x9C, lcd_cmd_data_138, 1, 0},
    {0x9D, lcd_cmd_data_139, 1, 0},
    {0x9E, lcd_cmd_data_140, 1, 0},
    {0x9F, lcd_cmd_data_141, 1, 0},
    // {0xA0, lcd_cmd_data_142, 1, 0},
    {0xA0, lcd_cmd_data_143, 1, 0},
    {0xA1, lcd_cmd_data_144, 1, 0},
    // {0xA2, lcd_cmd_data_145, 1, 0},
    {0xA2, lcd_cmd_data_146, 1, 0},
    {0xA3, lcd_cmd_data_147, 1, 0},
    // {0xA4, lcd_cmd_data_148, 1, 0},
    {0xA4, lcd_cmd_data_149, 1, 0},
    {0xA5, lcd_cmd_data_150, 1, 0},
    {0xA6, lcd_cmd_data_151, 1, 0},
    {0xA7, lcd_cmd_data_152, 1, 0},
    // {0xA8, lcd_cmd_data_153, 1, 0},
    {0xA8, lcd_cmd_data_154, 1, 0},
    {0xA9, lcd_cmd_data_155, 1, 0},
    // {0xAA, lcd_cmd_data_156, 1, 0},
    {0xAA, lcd_cmd_data_157, 1, 0},
    {0xAB, lcd_cmd_data_158, 1, 0},
    // {0xAC, lcd_cmd_data_159, 1, 0},
    {0xAC, lcd_cmd_data_160, 1, 0},
    {0xAD, lcd_cmd_data_161, 1, 0},
    {0xAE, lcd_cmd_data_162, 1, 0},
    {0xAF, lcd_cmd_data_163, 1, 0},
    // {0xB0, lcd_cmd_data_164, 1, 0},
    {0xB0, lcd_cmd_data_165, 1, 0},
    {0xB1, lcd_cmd_data_166, 1, 0},
    // {0xB2, lcd_cmd_data_167, 1, 0},
    {0xB2, lcd_cmd_data_168, 1, 0},
    {0xB3, lcd_cmd_data_169, 1, 0},
    // {0xB4, lcd_cmd_data_170, 1, 0},
    {0xB4, lcd_cmd_data_171, 1, 0},
    {0xB5, lcd_cmd_data_172, 1, 0},
    {0xB6, lcd_cmd_data_173, 1, 0},
    {0xB7, lcd_cmd_data_174, 1, 0},
    // {0xB8, lcd_cmd_data_175, 1, 0},
    {0xB8, lcd_cmd_data_176, 1, 0},
    {0xB9, lcd_cmd_data_177, 1, 0},
    // {0xBA, lcd_cmd_data_178, 1, 0},
    {0xBA, lcd_cmd_data_179, 1, 0},
    {0xBB, lcd_cmd_data_180, 1, 0},
    // {0xBC, lcd_cmd_data_181, 1, 0},
    {0xBC, lcd_cmd_data_182, 1, 0},
    {0xBD, lcd_cmd_data_183, 1, 0},
    {0xBE, lcd_cmd_data_184, 1, 0},
    {0xBF, lcd_cmd_data_185, 1, 0},
    // {0xC0, lcd_cmd_data_186, 1, 0},
    {0xC0, lcd_cmd_data_187, 1, 0},
    {0xC1, lcd_cmd_data_188, 1, 0},
    {0xC2, lcd_cmd_data_189, 1, 0},
    {0xC3, lcd_cmd_data_190, 1, 0},
    {0xC4, lcd_cmd_data_191, 1, 0},
    {0xC5, lcd_cmd_data_192, 1, 0},
    {0xC6, lcd_cmd_data_193, 1, 0},
    {0xC7, lcd_cmd_data_194, 1, 0},
    {0xC8, lcd_cmd_data_195, 1, 0},
    {0xC9, lcd_cmd_data_196, 1, 0},
    // {0xD0, lcd_cmd_data_197, 1, 0},
    {0xD0, lcd_cmd_data_198, 1, 0},
    {0xD1, lcd_cmd_data_199, 1, 0},
    {0xD2, lcd_cmd_data_200, 1, 0},
    {0xD3, lcd_cmd_data_201, 1, 0},
    {0xD4, lcd_cmd_data_202, 1, 0},
    {0xD5, lcd_cmd_data_203, 1, 0},
    {0xD6, lcd_cmd_data_204, 1, 0},
    {0xD7, lcd_cmd_data_205, 1, 0},
    {0xD8, lcd_cmd_data_206, 1, 0},
    {0xD9, lcd_cmd_data_207, 1, 0},
    {0xF3, lcd_cmd_data_208, 1, 0},
    {0xF0, lcd_cmd_data_209, 1, 0},
    // {0x3A, lcd_cmd_data_210, 1, 0},
    {0x35, lcd_cmd_data_211, 1, 0},
    {0x21, lcd_cmd_data_212, 0, 0},
    {0x11, lcd_cmd_data_213, 0, 120},
    {0x29, lcd_cmd_data_214, 0, 0},
};
static const st77916_lcd_init_cmd_t vendor_specific_init_version_2[] = {
  {0xF0, lcd_cmd_data_215, 1, 0},
  {0xF2, lcd_cmd_data_216, 1, 0},
  {0x73, lcd_cmd_data_217, 1, 0},
  {0x7C, lcd_cmd_data_218, 1, 0},
  {0x83, lcd_cmd_data_219, 1, 0},
  {0x84, lcd_cmd_data_220, 1, 0},
  {0xF2, lcd_cmd_data_221, 1, 0},
  {0xF0, lcd_cmd_data_222, 1, 0},
  {0xF0, lcd_cmd_data_223, 1, 0},
  {0xF1, lcd_cmd_data_224, 1, 0},
  {0xB0, lcd_cmd_data_225, 1, 0},
  {0xB1, lcd_cmd_data_226, 1, 0},
  {0xB2, lcd_cmd_data_227, 1, 0},
  {0xB4, lcd_cmd_data_228, 1, 0},
  {0xB5, lcd_cmd_data_229, 1, 0},
  {0xB6, lcd_cmd_data_230, 1, 0},
  {0xB7, lcd_cmd_data_231, 1, 0},
  {0xB8, lcd_cmd_data_232, 1, 0},
  {0xBA, lcd_cmd_data_233, 1, 0},
  {0xBB, lcd_cmd_data_234, 1, 0},
  {0xBC, lcd_cmd_data_235, 1, 0},
  {0xBD, lcd_cmd_data_236, 1, 0},
  {0xC0, lcd_cmd_data_237, 1, 0},
  {0xC1, lcd_cmd_data_238, 1, 0},
  {0xC2, lcd_cmd_data_239, 1, 0},
  {0xC3, lcd_cmd_data_240, 1, 0},
  {0xC4, lcd_cmd_data_241, 1, 0},
  {0xC5, lcd_cmd_data_242, 1, 0},
  {0xC6, lcd_cmd_data_243, 1, 0},
  {0xC7, lcd_cmd_data_244, 1, 0},
  {0xC8, lcd_cmd_data_245, 1, 0},
  {0xC9, lcd_cmd_data_246, 1, 0},
  {0xCA, lcd_cmd_data_247, 1, 0},
  {0xCB, lcd_cmd_data_248, 1, 0},
  {0xD0, lcd_cmd_data_249, 1, 0},
  {0xD1, lcd_cmd_data_250, 1, 0},
  {0xD2, lcd_cmd_data_251, 1, 0},
  {0xF5, lcd_cmd_data_252, 2, 0},
  {0xDD, lcd_cmd_data_253, 1, 0},
  {0xDE, lcd_cmd_data_254, 1, 0},
  {0xF1, lcd_cmd_data_255, 1, 0},
  {0xF0, lcd_cmd_data_256, 1, 0},
  {0xF0, lcd_cmd_data_257, 1, 0},
  {0xE0, lcd_cmd_data_258, 14, 0},
  {0xE1, lcd_cmd_data_259, 14, 0},
  {0xF0, lcd_cmd_data_260, 1, 0},
  {0xF3, lcd_cmd_data_261, 1, 0},
  {0xE0, lcd_cmd_data_262, 1, 0},
  {0xE1, lcd_cmd_data_263, 1, 0},
  {0xE2, lcd_cmd_data_264, 1, 0},
  {0xE3, lcd_cmd_data_265, 1, 0},
  {0xE4, lcd_cmd_data_266, 1, 0},
  {0xE5, lcd_cmd_data_267, 1, 0},
  {0xE6, lcd_cmd_data_268, 1, 0},
  {0xE7, lcd_cmd_data_269, 1, 0},
  {0xE8, lcd_cmd_data_270, 1, 0},
  {0xE9, lcd_cmd_data_271, 1, 0},
  {0xEA, lcd_cmd_data_272, 1, 0},
  {0xEB, lcd_cmd_data_273, 1, 0},
  {0xEC, lcd_cmd_data_274, 1, 0},
  {0xED, lcd_cmd_data_275, 1, 0},
  {0xEE, lcd_cmd_data_276, 1, 0},
  {0xEF, lcd_cmd_data_277, 1, 0},
  {0xF8, lcd_cmd_data_278, 1, 0},
  {0xF9, lcd_cmd_data_279, 1, 0},
  {0xFA, lcd_cmd_data_280, 1, 0},
  {0xFB, lcd_cmd_data_281, 1, 0},
  {0xFC, lcd_cmd_data_282, 1, 0},
  {0xFD, lcd_cmd_data_283, 1, 0},
  {0xFE, lcd_cmd_data_284, 1, 0},
  {0xFF, lcd_cmd_data_285, 1, 0},
  {0x60, lcd_cmd_data_286, 1, 0},
  {0x61, lcd_cmd_data_287, 1, 0},
  {0x62, lcd_cmd_data_288, 1, 0},
  {0x63, lcd_cmd_data_289, 1, 0},
  {0x64, lcd_cmd_data_290, 1, 0},
  {0x65, lcd_cmd_data_291, 1, 0},
  {0x66, lcd_cmd_data_292, 1, 0},
  {0x67, lcd_cmd_data_293, 1, 0},
  {0x68, lcd_cmd_data_294, 1, 0},
  {0x69, lcd_cmd_data_295, 1, 0},
  {0x6A, lcd_cmd_data_296, 1, 0},
  {0x6B, lcd_cmd_data_297, 1, 0},
  {0x70, lcd_cmd_data_298, 1, 0},
  {0x71, lcd_cmd_data_299, 1, 0},
  {0x72, lcd_cmd_data_300, 1, 0},
  {0x73, lcd_cmd_data_301, 1, 0},
  {0x74, lcd_cmd_data_302, 1, 0},
  {0x75, lcd_cmd_data_303, 1, 0},
  {0x76, lcd_cmd_data_304, 1, 0},
  {0x77, lcd_cmd_data_305, 1, 0},
  {0x78, lcd_cmd_data_306, 1, 0},
  {0x79, lcd_cmd_data_307, 1, 0},
  {0x7A, lcd_cmd_data_308, 1, 0},
  {0x7B, lcd_cmd_data_309, 1, 0},
  {0x80, lcd_cmd_data_310, 1, 0},
  {0x81, lcd_cmd_data_311, 1, 0},
  {0x82, lcd_cmd_data_312, 1, 0},
  {0x83, lcd_cmd_data_313, 1, 0},
  {0x84, lcd_cmd_data_314, 1, 0},
  {0x85, lcd_cmd_data_315, 1, 0},
  {0x86, lcd_cmd_data_316, 1, 0},
  {0x87, lcd_cmd_data_317, 1, 0},
  {0x88, lcd_cmd_data_318, 1, 0},
  {0x89, lcd_cmd_data_319, 1, 0},
  {0x8A, lcd_cmd_data_320, 1, 0},
  {0x8B, lcd_cmd_data_321, 1, 0},
  {0x8C, lcd_cmd_data_322, 1, 0},
  {0x8D, lcd_cmd_data_323, 1, 0},
  {0x8E, lcd_cmd_data_324, 1, 0},
  {0x8F, lcd_cmd_data_325, 1, 0},
  {0x90, lcd_cmd_data_326, 1, 0},
  {0x91, lcd_cmd_data_327, 1, 0},
  {0x92, lcd_cmd_data_328, 1, 0},
  {0x93, lcd_cmd_data_329, 1, 0},
  {0x94, lcd_cmd_data_330, 1, 0},
  {0x95, lcd_cmd_data_331, 1, 0},
  {0x96, lcd_cmd_data_332, 1, 0},
  {0x97, lcd_cmd_data_333, 1, 0},
  {0x98, lcd_cmd_data_334, 1, 0},
  {0x99, lcd_cmd_data_335, 1, 0},
  {0x9A, lcd_cmd_data_336, 1, 0},
  {0x9B, lcd_cmd_data_337, 1, 0},
  {0x9C, lcd_cmd_data_338, 1, 0},
  {0x9D, lcd_cmd_data_339, 1, 0},
  {0x9E, lcd_cmd_data_340, 1, 0},
  {0x9F, lcd_cmd_data_341, 1, 0},
  {0xA0, lcd_cmd_data_342, 1, 0},
  {0xA1, lcd_cmd_data_343, 1, 0},
  {0xA2, lcd_cmd_data_344, 1, 0},
  {0xA3, lcd_cmd_data_345, 1, 0},
  {0xA4, lcd_cmd_data_346, 1, 0},
  {0xA5, lcd_cmd_data_347, 1, 0},
  {0xA6, lcd_cmd_data_348, 1, 0},
  {0xA7, lcd_cmd_data_349, 1, 0},
  {0xA8, lcd_cmd_data_350, 1, 0},
  {0xA9, lcd_cmd_data_351, 1, 0},
  {0xAA, lcd_cmd_data_352, 1, 0},
  {0xAB, lcd_cmd_data_353, 1, 0},
  {0xAC, lcd_cmd_data_354, 1, 0},
  {0xAD, lcd_cmd_data_355, 1, 0},
  {0xAE, lcd_cmd_data_356, 1, 0},
  {0xAF, lcd_cmd_data_357, 1, 0},
  {0xB0, lcd_cmd_data_358, 1, 0},
  {0xB1, lcd_cmd_data_359, 1, 0},
  {0xB2, lcd_cmd_data_360, 1, 0},
  {0xB3, lcd_cmd_data_361, 1, 0},
  {0xB4, lcd_cmd_data_362, 1, 0},
  {0xB5, lcd_cmd_data_363, 1, 0},
  {0xB6, lcd_cmd_data_364, 1, 0},
  {0xB7, lcd_cmd_data_365, 1, 0},

  {0xB8, lcd_cmd_data_366, 1, 0},
  {0xB9, lcd_cmd_data_367, 1, 0},
  {0xBA, lcd_cmd_data_368, 1, 0},
  {0xBB, lcd_cmd_data_369, 1, 0},
  {0xBC, lcd_cmd_data_370, 1, 0},
  {0xBD, lcd_cmd_data_371, 1, 0},
  {0xBE, lcd_cmd_data_372, 1, 0},
  {0xBF, lcd_cmd_data_373, 1, 0},
  {0xC0, lcd_cmd_data_374, 1, 0},
  {0xC1, lcd_cmd_data_375, 1, 0},
  {0xC2, lcd_cmd_data_376, 1, 0},
  {0xC3, lcd_cmd_data_377, 1, 0},
  {0xC4, lcd_cmd_data_378, 1, 0},
  {0xC5, lcd_cmd_data_379, 1, 0},
  {0xC6, lcd_cmd_data_380, 1, 0},
  {0xC7, lcd_cmd_data_381, 1, 0},
  {0xC8, lcd_cmd_data_382, 1, 0},
  {0xC9, lcd_cmd_data_383, 1, 0},
  {0xD0, lcd_cmd_data_384, 1, 0},
  {0xD1, lcd_cmd_data_385, 1, 0},
  {0xD2, lcd_cmd_data_386, 1, 0},
  {0xD3, lcd_cmd_data_387, 1, 0},
  {0xD4, lcd_cmd_data_388, 1, 0},
  {0xD5, lcd_cmd_data_389, 1, 0},
  {0xD6, lcd_cmd_data_390, 1, 0},
  {0xD7, lcd_cmd_data_391, 1, 0},
  {0xD8, lcd_cmd_data_392, 1, 0},
  {0xD9, lcd_cmd_data_393, 1, 0},
  {0xF3, lcd_cmd_data_394, 1, 0},
  {0xF0, lcd_cmd_data_395, 1, 0},
  {0x35, lcd_cmd_data_396, 1, 0},
  {0x21, lcd_cmd_data_397, 1, 0},
  {0x11, lcd_cmd_data_398, 1, 120},
  {0x29, lcd_cmd_data_399, 1, 0},
};
